/***************************************************************************************************
  В этом файле лежат макросы и инлайн-функции для семейства stm32f4xx
  
***************************************************************************************************/

#pragma once


// Этот файл предназначен только для процессоров f40x
#if defined(STM32F4XX) || defined(STM32F40_41xxx) || defined(STM32F427_437xx) || defined(STM32F429_439xx) || defined(STM32F401xx) || defined(STM32F410xx) || \
    defined(STM32F411xE) || defined(STM32F446xx) || defined(STM32F469_479xx) 

#include "project_config.h"

/***************************************************************************************************
                            Глобальные дефайны
***************************************************************************************************/

/***************************************************************************************************
                            Глобальные типы данных
***************************************************************************************************/

/***************************************************************************************************
                            Глобальные inline функции
***************************************************************************************************/

/**************************************************************************************************
Описание:   Функция преобразования порта в номер для тактирования через RCC_AHB1PeriphClockCmd
Аргументы:  Порт
Возврат:    Номер для тактирования
Замечания: 
**************************************************************************************************/
inline uint32_t gpioToRcc( GPIO_TypeDef * gpio)
{
    if(gpio == GPIOA)
        return RCC_AHB1Periph_GPIOA;
        
    else if(gpio == GPIOB)
        return RCC_AHB1Periph_GPIOB;
        
    else if(gpio == GPIOC)
        return RCC_AHB1Periph_GPIOC;
        
    else if(gpio == GPIOD)
        return RCC_AHB1Periph_GPIOD;
        
    else if(gpio == GPIOE)
        return RCC_AHB1Periph_GPIOE;
        
    else if(gpio == GPIOF)
        return RCC_AHB1Periph_GPIOF;
        
    else if(gpio == GPIOG)
        return RCC_AHB1Periph_GPIOG;
        
    else if(gpio == GPIOH)
        return RCC_AHB1Periph_GPIOH;
    
    else if(gpio == GPIOI)
        return RCC_AHB1Periph_GPIOI;
        
    else
    {
        UMBA_ASSERT_FAIL();
        return 0;
    }
    
    
}


/***************************************************************************************************
                            Глобальные прототипы функций
***************************************************************************************************/

#endif
