/***************************************************************************************************
  В этом файле лежат макросы и инлайн-функции для семейства stm32f1xx
  
***************************************************************************************************/

#pragma once


// Этот файл предназначен только для процессоров f10x
#if defined (STM32F10X_LD) || defined (STM32F10X_LD_VL) || defined (STM32F10X_MD) || defined (STM32F10X_MD_VL) || defined (STM32F10X_HD) || defined (STM32F10X_HD_VL) || defined (STM32F10X_XL) || defined (STM32F10X_CL)

#include "project_config.h"


/***************************************************************************************************
                            Глобальные дефайны
***************************************************************************************************/

/***************************************************************************************************
                            Глобальные типы данных
***************************************************************************************************/

/***************************************************************************************************
                            Глобальные inline функции
***************************************************************************************************/

/**************************************************************************************************
Описание:   Функция преобразования порта в номер для тактирования через RCC_APB2PeriphClockCmd
Аргументы:  Порт
Возврат:    Номер для тактирования
Замечания: 
**************************************************************************************************/
inline uint32_t gpioToRcc( GPIO_TypeDef * gpio)
{
    if(gpio == GPIOA)
        return RCC_APB2Periph_GPIOA;
        
    else if(gpio == GPIOB)
        return RCC_APB2Periph_GPIOB;
        
    else if(gpio == GPIOC)
        return RCC_APB2Periph_GPIOC;
        
    else if(gpio == GPIOD)
        return RCC_APB2Periph_GPIOD;
        
    else if(gpio == GPIOE)
        return RCC_APB2Periph_GPIOE;
        
    else if(gpio == GPIOF)
        return RCC_APB2Periph_GPIOF;
        
    else if(gpio == GPIOG)
        return RCC_APB2Periph_GPIOG;
        
    else
    {
        UMBA_ASSERT_FAIL();
        return 0;
    }
    
    
}


/***************************************************************************************************
                            Глобальные прототипы функций
***************************************************************************************************/

#endif
