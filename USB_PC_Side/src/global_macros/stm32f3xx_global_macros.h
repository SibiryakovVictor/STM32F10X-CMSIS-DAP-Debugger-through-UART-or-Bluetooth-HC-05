/***************************************************************************************************
  В этом файле лежат макросы и инлайн-функции для семейства stm32f1xx
  
***************************************************************************************************/

#pragma once


// Этот файл предназначен только для процессоров f30x
#if defined (STM32F303xC) || defined (STM32F334x8) || defined (STM32F302x8) || defined (STM32F303xE)

#include "project_config.h"


/***************************************************************************************************
                            Глобальные дефайны
***************************************************************************************************/

/***************************************************************************************************
                            Глобальные типы данных
***************************************************************************************************/

/***************************************************************************************************
                            Глобальные inline функции
***************************************************************************************************/

/**************************************************************************************************
Описание:   Функция преобразования порта в номер для тактирования через RCC_APB2PeriphClockCmd
Аргументы:  Порт
Возврат:    Номер для тактирования
Замечания: 
**************************************************************************************************/
inline uint32_t gpioToRcc( GPIO_TypeDef * gpio)
{
    if(gpio == GPIOA)
        return RCC_AHBPeriph_GPIOA;
        
    else if(gpio == GPIOB)
        return RCC_AHBPeriph_GPIOB;
        
    else if(gpio == GPIOC)
        return RCC_AHBPeriph_GPIOC;
        
    else if(gpio == GPIOD)
        return RCC_AHBPeriph_GPIOD;
        
    else if(gpio == GPIOE)
        return RCC_AHBPeriph_GPIOE;
        
    else if(gpio == GPIOF)
        return RCC_AHBPeriph_GPIOF;
        
    else if(gpio == GPIOG)
        return RCC_AHBPeriph_GPIOG;

    else if(gpio == GPIOH)
        return RCC_AHBPeriph_GPIOH;
        
    else
    {
        UMBA_ASSERT_FAIL();
        return 0;
    }
    
    
}


/***************************************************************************************************
                            Глобальные прототипы функций
***************************************************************************************************/

#endif
