/***************************************************************************************************
  В этом файле лежат макросы и инлайн-функции для семейства stm32f1xx
  
***************************************************************************************************/

#pragma once


// Этот файл предназначен только для процессоров f10x
#if defined (STM32L1XX_MD) || defined (STM32L1XX_MDP) || defined (STM32L1XX_HD) || defined (STM32L1XX_XL)

#include "project_config.h"


/***************************************************************************************************
                            Глобальные дефайны
***************************************************************************************************/

/***************************************************************************************************
                            Глобальные типы данных
***************************************************************************************************/

/***************************************************************************************************
                            Глобальные inline функции
***************************************************************************************************/

/**************************************************************************************************
Описание:   Функция преобразования порта в номер для тактирования через RCC_AHBPeriphClockCmd
Аргументы:  Порт
Возврат:    Номер для тактирования
Замечания: 
**************************************************************************************************/
inline uint32_t gpioToRcc( GPIO_TypeDef * gpio)
{
    if(gpio == GPIOA)
        return RCC_AHBPeriph_GPIOA;
        
    else if(gpio == GPIOB)
        return RCC_AHBPeriph_GPIOB;
        
    else if(gpio == GPIOC)
        return RCC_AHBPeriph_GPIOC;
        
    else if(gpio == GPIOD)
        return RCC_AHBPeriph_GPIOD;
        
    else if(gpio == GPIOE)
        return RCC_AHBPeriph_GPIOE;
        
    else if(gpio == GPIOF)
        return RCC_AHBPeriph_GPIOF;
        
    else if(gpio == GPIOG)
        return RCC_AHBPeriph_GPIOG;
        
    else
    {
        UMBA_ASSERT_FAIL();
        return 0;
    }
    
    
}


/***************************************************************************************************
                            Глобальные прототипы функций
***************************************************************************************************/

#endif
